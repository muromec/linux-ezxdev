## drivers/power_ic/Config.in
```kconfig
# /vobs/ezx_linux/code/linux/linux-2.4.17/drivers/power_ic/Config.in
#
# Description - Configuration file for Power IC driver.
#
# Copyright (C) 2005 - Motorola
#
#  This program is free software; you can redistribute it and/or modify
#  it under the terms of the GNU General Public License version 2 as
#  published by the Free Software Foundation.
#
#  This program is distributed in the hope that it will be useful,
#  but WITHOUT ANY WARRANTY; without even the implied warranty of
#  MERCHANTABILITY or FITNESS FOR A PARTICULAR PURPOSE.  See the
#  GNU General Public License for more details.
#
#  You should have received a copy of the GNU General Public License
#  along with this program; if not, write to the Free Software
#  Foundation, Inc., 59 Temple Place, Suite 330, Boston, MA  02111-1307  USA
#
# Motorola 2005-Feb-28 - Rewrote the software for PCAP.
# Motorola 2005-Jul-21 - Finalized the file.

mainmenu_option next_comment
comment 'Power IC driver'

if [ "$CONFIG_ARM" = "y" ]; then
   if [ "$CONFIG_CPU_BULVERDE" = "y" ]; then
      bool '  Power IC support' CONFIG_MOT_POWER_IC

      if [ "$CONFIG_MOT_POWER_IC" = "y" ]; then
         mainmenu_option next_comment
         comment 'Power IC settings'
	 comment 'Power IC type'
         choice 'Power IC type' \
            "PCAP2                    CONFIG_MOT_POWER_IC_PCAP2  \
             Atlas                    CONFIG_MOT_POWER_IC_ATLAS" PCAP2

     comment 'Headset type'
         choice 'Headset type' \
            "Stereo35                 CONFIG_MOT_POWER_IC_BARREL_HEADSET_STEREO_3MM5  \
             Stereo                   CONFIG_MOT_POWER_IC_BARREL_HEADSET_STEREO  \
             Mono                     CONFIG_MOT_POWER_IC_BARREL_HEADSET_MONO    \
             None                     CONFIG_MOT_POWER_IC_BARREL_HEADSET_NONE" Stereo

         comment 'Memory Card Supply to determine power supply'
	 comment 'For PCAP2: TRANSFLASH = VAUX3 SD = VAUX2' 
         choice 'Memory Card Supply' \
            "TRANSFLASH               CONFIG_MOT_POWER_IC_MEM_CARD_SPLY_TRANSFLASH  \
             SD                       CONFIG_MOT_POWER_IC_MEM_CARD_SPLY_SD" TRANSFLASH

         comment 'To determine power supplies for Bluetooth and WLAN'
	 comment 'For Old Config: Bluetooth = VAUX1  WLAN = V6 and VAUX2' 
         choice 'Bluetooth Supply' \
            "BLUETOOTH_ON_V6          CONFIG_MOT_POWER_IC_BLUETOOTH_SPLY_V6  \
             BLUETOOTH_ON_VAUX1       CONFIG_MOT_POWER_IC_BLUETOOTH_SPLY_VAUX1" BLUETOOTH_ON_V6

         comment 'To determine SPI operating in interrupt handler'
	 comment 'it will improve the touchscreen feature performance' 
         bool '  Support SPI operate directly in interrupt handler ' CONFIG_MOT_POWER_IC_PCAP2_SPI_BUS_INTERRUPT

         comment 'To determin BP control SW2 bit'
         comment 'It will decrease the power consumption'
         bool '  Let BP control SW2 bit  ' CONFIG_ARCH_EZX_BP_CONTROL_SW2

         comment 'Power IC debug trace'
         bool '    Build with kernel trace messages?' CONFIG_MOT_POWER_IC_TRACEMSG
         endmenu
      fi
   fi
fi

endmenu
```

## drivers/power_ic/core/Kconfig
```kconfig
# /vobs/ezx_linux/code/linux/linux-2.4.17/drivers/power_ic/core/Kconfig
#
# Description - Character device configuration.
#
# Copyright (C) 2005 - Motorola
#
#  This program is free software; you can redistribute it and/or modify
#  it under the terms of the GNU General Public License version 2 as
#  published by the Free Software Foundation.
#
#  This program is distributed in the hope that it will be useful,
#  but WITHOUT ANY WARRANTY; without even the implied warranty of
#  MERCHANTABILITY or FITNESS FOR A PARTICULAR PURPOSE.  See the
#  GNU General Public License for more details.
#
#  You should have received a copy of the GNU General Public License
#  along with this program; if not, write to the Free Software
#  Foundation, Inc., 59 Temple Place, Suite 330, Boston, MA  02111-1307  USA
#
# Motorola 2005-Mar-25 - File re-written from scratch

menu "Power IC support"

config MOT_POWER_IC
	tristate "Motorola Power IC"
    depends on ATLAS
    ---help---
    This configuration enables the Power IC to be used by SCM-A11

config MOT_POWER_IC_ATLAS
	tristate "Motorola Power IC"
    depends on MOT_POWER_IC
    ---help---
    This configuration enables the Atlas to be used by SCM-A11 without affecting EzX	
endmenu
```

## drivers/usb/device/Config.in
```kconfig
#
# USB device configuration from the device viewpoint (e.g. Linux running inside a USB device, not as host)
#
# Copyright (C) 2001 Lineo, Inc.
# Copyright (C) 2001 Hewlett-Packard Co.
mainmenu_option next_comment

comment 'USB Device Support'

dep_tristate 'Support for USB Devices (as device, not host) (EXPERIMENTAL)' CONFIG_USBD $CONFIG_EXPERIMENTAL

if [ "$CONFIG_USBD" = "y" -o "$CONFIG_USBD" = "m" ]; then
   hex    'VendorID (hex value)' CONFIG_USBD_VENDORID "0000"
   hex    'ProductID (hex value)' CONFIG_USBD_PRODUCTID "0000"
   string '  Product Name' CONFIG_USBD_PRODUCT_NAME "" 
   string '  Manufacturer' CONFIG_USBD_MANUFACTURER ""

   bool   '   Use Serial Number in Device Descriptor' CONFIG_USBD_USE_SERIAL_NUMBER
   if [ "$CONFIG_USBD_USE_SERIAL_NUMBER" = "y" ]; then
      string '  Default Serial number (string)' CONFIG_USBD_SERIAL_NUMBER_STR ""
   fi

   bool   '   Self Powered' CONFIG_USBD_SELFPOWERED
   if [ ! "$CONFIG_USBD_SELFPOWERED" = "y" ]; then
      int '   Max Power (mA)' CONFIG_USBD_MAXPOWER "0"
   fi

   bool   '   EP0 support' CONFIG_USBD_EP0_SUPPORT

   tristate '   USB Device Monitor' CONFIG_USBD_MONITOR

   comment ''

   bool   '  USBD Proc FS' CONFIG_USBD_PROCFS

   comment 'USB Device functions'
   source drivers/usb/device/net_fd/Config.in
   source drivers/usb/device/serial_fd/Config.in
   source drivers/usb/device/mouse_fd/Config.in
   source drivers/usb/device/storage_fd/Config.in
   source drivers/usb/device/test_fd/Config.in
	
   comment 'USB Device bus interfaces'
   source drivers/usb/device/bi/Config.in
fi

endmenu
```

## drivers/usbd/Config.in
```kconfig
#
# USB device configuration from the device viewpoint (e.g. Linux running inside a USB device, not as host)
#
# Copyright (c) 2002-2003 Belcarra
#
#
# Copyright (C) 2005 Motorola Inc.
#
# add dsplog support  by a5035c, for EZX platform
# add network support  by a19553, for EZX platform
# add usb2.0 support by a16157, for EZX platform
#


mainmenu_option next_comment

comment 'USB clients (devices, not hosts)'

tristate 'Support for USB Clients (USB Device, not USB Host)' CONFIG_USBD

if [ "$CONFIG_USBD" = "y" -o "$CONFIG_USBD" = "m" ]; then
   comment ''
   bool   '   Enable High Speed Descriptors' CONFIG_USBD_HIGH_SPEED

   bool   '   Do Not Use Serial Number in Device Descriptor (Default is no' CONFIG_USBD_NO_SERIAL_NUMBER
   if [ "$CONFIG_USBD_NO_SERIAL_NUMBER" != "y" ]; then
      string '  Default Serial number (string)' CONFIG_USBD_SERIAL_NUMBER_STR ""
   fi

   int '   Max Power (mA) (Default is zero, whick is self powered)' CONFIG_USBD_MAXPOWER "0"

   comment ''

   bool   '  USBD Proc FS' CONFIG_USBD_PROCFS

   tristate   '  USBD Proc FS Module' CONFIG_USBD_PROCFSM $CONFIG_USBD

   comment 'Function Drivers'

   source drivers/usbd/network_fd/Config.in
   source drivers/usbd/acm_fd/Config.in

   source drivers/usbd/mouse_fd/Config.in
   source drivers/usbd/storage_fd/Config.in

   comment 'Bus Interface'

   source drivers/usbd/pxa_bi/Config.in
   source drivers/usbd/wmmx_bi/Config.in
   source drivers/usbd/isp_bi/Config.in

   bool '  USB Device Register Tracing' CONFIG_USBD_BI_REGISTER_TRACE
   if [ "$CONFIG_USBD" = "y" ]; then
      bool '  USB Device Manual Enable' CONFIG_USBD_BI_DELAY_ENABLE
   fi

   source drivers/usbd/pst_fd/Config.in
   source drivers/usbd/cfg11_fd/Config.in
   #source drivers/usbd/gen_bi/Config.in
   #source drivers/usbd/l7205_bi/Config.in
   #source drivers/usbd/sl11_bi/Config.in

   #source drivers/usbd/cdc_fd/Config.in
   #source drivers/usbd/serialnumber/Config.in
   #source drivers/usbd/audio_fd/Config.in
   #source drivers/usbd/eg_fd/Config.in
   #source drivers/usbd/keyboard_fd/Config.in
   source drivers/usbd/dsplog_fd/Config.in
   source drivers/usbd/nm_fd/Config.in
fi

endmenu
```
